## package/lava-test-shell/Config.in
```kconfig
config BR2_PACKAGE_LAVA_TEST_SHELL
	bool "lava-test-shell"
	help
	  LAVA scripts needed to run yaml files from linaros lava-dispatcher repository..
	  https://git.linaro.org/lava/lava-dispatcher.git
```

## package/linaro-testsuites/Config.in
```kconfig
config BR2_PACKAGE_LINARO_TESTSUITES
	bool "linaro_testsuites"
	help
	  Tests from linaros test repository.
	  http://releases.linaro.org/components/platform/linaro-test-suites
```
